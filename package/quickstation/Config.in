## package/quickstation/Config.in
```kconfig
config BR2_PACKAGE_QUICKSTATION
    bool "QuickStation"
    select BR2_PACKAGE_SDL2
    select BR2_PACKAGE_QT5
	select BR2_PACKAGE_QT5BASE_CONCURRENT
	select BR2_PACKAGE_QT5BASE_FONTCONFIG
	select BR2_PACKAGE_QT5BASE_OPENGL_LIB
	select BR2_PACKAGE_QT5BASE_EGLFS
	select BR2_PACKAGE_QT5BASE_SQLITE_SYSTEM
	select BR2_PACKAGE_QT5BASE_GIF
	select BR2_PACKAGE_QT5BASE_JPEG
	select BR2_PACKAGE_QT5BASE_PNG
	select BR2_PACKAGE_QT5SVG
	select BR2_PACKAGE_QT5GRAPHICALEFFECTS
	select BR2_PACKAGE_QT5MULTIMEDIA
	select BR2_PACKAGE_QT5BASE_LICENSE_APPROVED
	help
		A multi emulator frontend.

		https://gitlab.pasnox.com:${QS_PORT}/quickstation/quickstation.git

	comment "QuickStation requires a recent toolchain w/ C++, GLES, SDL2 and Qt Quick"
```
